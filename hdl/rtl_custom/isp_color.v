// isp_color.v - ISP colour stage: black level, lens-shading correction, white balance + exposure (closed loop), manual gains
//
// Replaces awb_frame.v in the ISP chain (same AXI-stream interface, same mode codes, same readback), measured need: docs/IMAGE_SHADING_2026-10-16.md §6
// (dark field 17.8 / 18.6 / 17.4 of 255, radial colour shading R/G and B/G +20..23 % at the corners, corner luminance 67 %).
// Per pixel, for channel c of a frame in mode AUTO or MAN:
//     out_c = min(255, (eff_c * max(0, in_c - BLK_c)) >> 12)       eff_c = min(65535, (gain_c * lsc_c(x, y)) >> 10)
// mode OFF: out = in (no black level, lsc = 1.0, gains 1.0) - the raw picture for comparisons and for the flat-field measurement.
// lsc_c(x, y) (Q2.10) comes from lsc_rom (21 x 13 nodes at x = 64 i, y = 64 j, generated by tools/shade/gen_lsc_table.py from a flat-field capture):
//     L_c(i, y) = T_c(j, i) + (((T_c(j + 1, i) - T_c(j, i)) * fy) >>> 6)            j = y >> 6, fy = y & 63   (per line, node by node)
//     lsc_c(beat b of the line) = (16 * L_c(s, y) + k * (L_c(s + 1, y) - L_c(s, y))) >> 4     s = b >> 4, k = b & 15  (one value per 4-pixel beat)
// The node values are fetched while the line runs (3 clocks per node, a new node every 16 beats); the first three nodes of a line are fetched in the
// line blanking (needs >= 12 idle clocks between the last beat of a line and the first beat of the next; the camera line gap is ~1000 clocks).
// Gains (Q4.12, 4096 = 1.0), taken at the first beat of a frame and held for it:  AUTO: the closed-loop estimate below, OFF: 1.0, MAN: I_man_*.
// Closed loop (white balance and exposure together): over the OUTPUT of every complete frame the first pixel of every VALID beat is summed per
// channel (valid: the input pixel has G >= BLK_G + V_LO and R, G, B < V_HI - no near-black noise, no clipped pixels); with n valid beats
// er_c = min(65535, gain_c * TARGET * n / sum_c) drives the mean of every channel to TARGET (equal means = gray world, their level =
// exposure); if the largest er_c is over GAIN_MAX all three are scaled by GAIN_MAX / max(er) (the R : G : B ratios stay, so a scene too dark for
// the limit comes out darker but neutral - with a per-channel clamp all gains would sit at the limit and the sensor's own green would show);
// est_c >= GAIN_MIN; auto_c = (gain_c + est_c + 1) >> 1 (half step: stable against the delay of the loop and the sensor's own exposure changes).
// gain_c here is the gain the measured frame was processed with, so the loop also converges after MAN / OFF frames. sum_c = 0 -> er_c = 65535.
// n < N_MIN (a dark or clipped scene with too few valid pixels): auto_c is kept (the white balance does not wander on noise).
// The arithmetic (per channel a 16-bit multiply + a 44 / 32-bit division, twice) runs sequentially after the frame (~420 clocks of the blanking).
// Interface (drop-in for awb.v / awb_frame.v): 96-bit beat = 4 pixels, pixel k = {R, G, B} at [24*k +: 24]; O_tuser is the INPUT tuser (vendor
// behaviour: video_in resets its FIFO on the stretched frame start), data / valid / tlast are delayed by DELAY + 3 clocks. I_tready = O_tready.
// O_gain_r / g / b: the white-balance / exposure gains of the current frame (without the lens-shading factor).
// A frame that starts while the line counter is not at line 0 (a truncated previous frame) uses the line-0 nodes prepared for it only if it was
// complete; otherwise the first line of that frame may use the nodes of the wrong line (one line, shading only). Truncated frames do not update auto_c.
// Reset: active-low asynchronous; gains 1.0. Area: 8 DSP (R / B pixel products) + 3 DSP (gain x lsc); G products and the node
// interpolation (d * fy) as shift-add; 1 ERAM (lsc_rom).

module isp_color #(
    parameter integer IMG_HEIGHT = 720,
    parameter integer IMG_WIDTH  = 1280,
    parameter integer DELAY      = 24,
    parameter [7:0]   BLK_R      = 8'd18,
    parameter [7:0]   BLK_G      = 8'd19,
    parameter [7:0]   BLK_B      = 8'd17,
    parameter integer TARGET     = 110,
    parameter [15:0]  GAIN_MIN   = 16'd1024,
    parameter [15:0]  GAIN_MAX   = 16'd32768,
    parameter integer LSC_EN     = 1,
    parameter [7:0]   V_LO       = 8'd4,           // statistics: only beats whose first pixel has G >= BLK_G + V_LO (above the noise floor) ...
    parameter [7:0]   V_HI       = 8'd250,         // ... and R, G, B < V_HI at the input (not clipped)
    parameter integer N_MIN      = 2304,           // fewer valid beats in a frame (1 %): the closed-loop gains are kept (dark / clipped scene)
    parameter integer GRAY_SH    = 0,              // 0: off. k > 0: a beat counts only if its first OUTPUT pixel is near grey, |R - G| and |B - G| <= G >> k
                                                   // (a large coloured area or a coloured glow no longer pulls the balance: the grey world uses grey pixels)
    parameter [15:0]  INIT_R     = 16'd4096,       // automatic gains after reset (Q4.12); with GRAY_SH the neutral gains of the camera, so that
    parameter [15:0]  INIT_G     = 16'd4096,       // grey objects are recognised as grey from the first frame on
    parameter [15:0]  INIT_B     = 16'd4096
)(
    input  wire        I_clk,
    input  wire        I_rst_n,
    input  wire [1:0]  I_mode,
    input  wire [15:0] I_man_r,
    input  wire [15:0] I_man_g,
    input  wire [15:0] I_man_b,
    output wire [15:0] O_gain_r,
    output wire [15:0] O_gain_g,
    output wire [15:0] O_gain_b,

    input  wire        I_tlast,
    input  wire        I_tuser,
    input  wire [95:0] I_tdata,
    input  wire        I_tvalid,
    output wire        I_tready,

    output wire        O_tlast,
    output wire        O_tuser,
    output wire [95:0] O_tdata,
    output wire        O_tvalid,
    input  wire        O_tready
);

    assign I_tready = O_tready;
    assign O_tuser  = I_tuser;

    localparam integer BPL = IMG_WIDTH / 4;                   // beats per line
    localparam [25:0]  TNMIN = TARGET * N_MIN;                // TARGET x the minimum number of valid beats
    localparam integer NX  = 21;                              // nodes per row

    // ---------------------------------------------------------------- delay RAM (as awb_frame): the stream DELAY - 1 clocks later
    localparam integer AW = 5;
    (* ram_style = "bram" *) reg [98:0] dmem [0:(1<<AW)-1];
    localparam [AW-1:0] DLY = DELAY;
    reg  [AW-1:0] wp;
    reg  [98:0]   rq;
    wire [AW-1:0] rp = wp - DLY + 1'b1;
    always @(posedge I_clk or negedge I_rst_n) begin
        if (!I_rst_n) wp <= {AW{1'b0}};
        else          wp <= wp + 1'b1;
    end
    always @(posedge I_clk) begin
        dmem[wp] <= {I_tuser & I_tvalid, I_tlast, I_tvalid, I_tdata};
        rq       <= dmem[rp];
    end
    reg [AW:0] init_cnt;
    reg        mem_ok;
    always @(posedge I_clk or negedge I_rst_n) begin
        if (!I_rst_n) begin init_cnt <= {(AW+1){1'b0}}; mem_ok <= 1'b0; end
        else if (!mem_ok) begin
            init_cnt <= init_cnt + 1'b1;
            if (init_cnt == (1 << AW) + 2) mem_ok <= 1'b1;
        end
    end
    wire        d_valid = rq[96] & mem_ok;
    wire        d_last  = rq[97] & mem_ok;
    wire        d_user  = rq[98] & mem_ok;
    wire [95:0] d_data  = rq[95:0];

    // ---------------------------------------------------------------- frame settings (taken at the first beat of a frame)
    reg  [15:0] g_r, g_g, g_b;                // gains of the current frame
    reg  [15:0] a_r, a_g, a_b;                // closed-loop (AUTO) gains for the next frame
    reg         raw_f;                        // current frame in mode OFF
    wire        m_off = (I_mode == 2'd1);
    wire        m_man = I_mode[1];
    wire [15:0] nf_r = m_man ? I_man_r : m_off ? 16'd4096 : a_r;
    wire [15:0] nf_g = m_man ? I_man_g : m_off ? 16'd4096 : a_g;
    wire [15:0] nf_b = m_man ? I_man_b : m_off ? 16'd4096 : a_b;
    wire        first = d_valid & d_user;
    wire [15:0] gu_r = first ? nf_r : g_r;
    wire [15:0] gu_g = first ? nf_g : g_g;
    wire [15:0] gu_b = first ? nf_b : g_b;
    wire        raw_u = first ? m_off : raw_f;
    always @(posedge I_clk or negedge I_rst_n) begin
        if (!I_rst_n) begin g_r <= 16'd4096; g_g <= 16'd4096; g_b <= 16'd4096; raw_f <= 1'b0; end
        else if (first) begin g_r <= nf_r; g_g <= nf_g; g_b <= nf_b; raw_f <= m_off; end
    end
    assign O_gain_r = g_r;
    assign O_gain_g = g_g;
    assign O_gain_b = g_b;

    // ---------------------------------------------------------------- lens shading: node fetch + per-beat interpolation
    reg  [9:0]  ly;                           // line of the current / next beat
    reg  [8:0]  bx;                           // beat inside the line
    reg  [15:0] acc_r, acc_g, acc_b;          // 16 x lsc of the current beat
    reg  signed [13:0] sl_r, sl_g, sl_b;      // per-beat step x 16 = L(s+1) - L(s)
    reg  [11:0] rt_r, rt_g, rt_b;             // L(s+1)
    reg  [11:0] nx_r, nx_g, nx_b;             // L(s+2)
    reg  [35:0] ls0, ls1;                     // line start: L(0), L(1)

    // fetch unit: node `f_node` of line `f_line` -> `f_val` (3 clocks)
    reg  [1:0]  f_st;                         // 0 idle, 1 row j presented, 2 row j+1 presented, 3 result
    reg  [4:0]  f_node;
    reg  [9:0]  f_line;
    reg  [1:0]  f_job;                        // 0 next node (-> nx), 1..3 line start node 0 / 1 / 2
    reg  [35:0] f_t0;
    wire [35:0] rom_q;
    wire [3:0]  f_row = f_line[9:6];
    wire [5:0]  f_fy  = f_line[5:0];
    wire [8:0]  rom_a = (f_st == 2'd1) ? {5'd0, f_row} * NX + {4'd0, f_node} : ({5'd0, f_row} + 9'd1) * NX + {4'd0, f_node};   // state 1: row j, then row j + 1
    lsc_rom u_rom (.clk(I_clk), .addr(rom_a), .data(rom_q));

    function [11:0] vint;                     // T0 + ((T1 - T0) * fy) >>> 6
        input [11:0] t0;
        input [11:0] t1;
        input [5:0]  fy;
        reg signed [12:0] d;
        reg signed [19:0] p;
        reg signed [13:0] s;
        begin
            d = $signed({1'b0, t1}) - $signed({1'b0, t0});
            p = (fy[0] ? d : 13'sd0) + (fy[1] ? d <<< 1 : 13'sd0) + (fy[2] ? d <<< 2 : 13'sd0) +            // d * fy as shift-add (no DSP)
                (fy[3] ? d <<< 3 : 13'sd0) + (fy[4] ? d <<< 4 : 13'sd0) + (fy[5] ? d <<< 5 : 13'sd0);
            s = $signed({2'b00, t0}) + (p >>> 6);
            vint = s[11:0];
        end
    endfunction
    wire [35:0] f_val = {vint(f_t0[35:24], rom_q[35:24], f_fy), vint(f_t0[23:12], rom_q[23:12], f_fy), vint(f_t0[11:0], rom_q[11:0], f_fy)};

    wire        b_seg_end = d_valid && (bx[3:0] == 4'd15) && !d_last;
    wire [4:0]  seg_n3    = (bx[8:4] + 5'd3 > 5'd20) ? 5'd20 : bx[8:4] + 5'd3;
    wire [9:0]  ly_next   = (ly == IMG_HEIGHT - 1) ? 10'd0 : ly + 10'd1;

    reg         start_line;                   // request: fetch the first three nodes of line `pl_req`
    reg  [9:0]  pl_req;
    always @(posedge I_clk or negedge I_rst_n) begin
        if (!I_rst_n) begin
            ly <= 10'd0; bx <= 9'd0; f_st <= 2'd0; f_node <= 5'd0; f_line <= 10'd0; f_job <= 2'd0; f_t0 <= 36'd0;
            acc_r <= 16'd0; acc_g <= 16'd0; acc_b <= 16'd0; sl_r <= 14'sd0; sl_g <= 14'sd0; sl_b <= 14'sd0;
            rt_r <= 12'd0; rt_g <= 12'd0; rt_b <= 12'd0; nx_r <= 12'd0; nx_g <= 12'd0; nx_b <= 12'd0; ls0 <= 36'd0; ls1 <= 36'd0;
            start_line <= 1'b1; pl_req <= 10'd0;
        end
        else begin
            // ---- per beat: position and interpolation
            if (d_valid) begin
                if (d_last) begin
                    bx <= 9'd0;
                    ly <= ly_next;
                    start_line <= 1'b1; pl_req <= ly_next;
                end
                else bx <= bx + 9'd1;
                if (d_user) ly <= (d_last) ? ly_next : 10'd0;
                if (b_seg_end) begin
                    acc_r <= {rt_r, 4'd0}; acc_g <= {rt_g, 4'd0}; acc_b <= {rt_b, 4'd0};
                    sl_r <= $signed({2'b00, nx_r}) - $signed({2'b00, rt_r});
                    sl_g <= $signed({2'b00, nx_g}) - $signed({2'b00, rt_g});
                    sl_b <= $signed({2'b00, nx_b}) - $signed({2'b00, rt_b});
                    rt_r <= nx_r; rt_g <= nx_g; rt_b <= nx_b;
                end
                else if (!d_last) begin
                    acc_r <= acc_r + {{2{sl_r[13]}}, sl_r};
                    acc_g <= acc_g + {{2{sl_g[13]}}, sl_g};
                    acc_b <= acc_b + {{2{sl_b[13]}}, sl_b};
                end
            end
            // ---- fetch unit
            case (f_st)
                2'd0: begin
                    if (start_line) begin
                        start_line <= 1'b0; f_line <= pl_req; f_node <= 5'd0; f_job <= 2'd1; f_st <= 2'd1;
                    end
                    else if (b_seg_end) begin
                        f_line <= ly; f_node <= seg_n3; f_job <= 2'd0; f_st <= 2'd1;
                    end
                end
                2'd1: f_st <= 2'd2;                                  // rom_q = row j word next clock
                2'd2: begin f_t0 <= rom_q; f_st <= 2'd3; end
                default: begin                                       // rom_q = row j + 1 word: f_val valid
                    f_st <= 2'd0;
                    case (f_job)
                        2'd0: begin nx_r <= f_val[35:24]; nx_g <= f_val[23:12]; nx_b <= f_val[11:0]; end
                        2'd1: begin ls0 <= f_val; f_node <= 5'd1; f_job <= 2'd2; f_st <= 2'd1; end
                        2'd2: begin ls1 <= f_val; f_node <= 5'd2; f_job <= 2'd3; f_st <= 2'd1; end
                        default: begin                               // line start complete: L(0), L(1), L(2)
                            acc_r <= {ls0[35:24], 4'd0}; acc_g <= {ls0[23:12], 4'd0}; acc_b <= {ls0[11:0], 4'd0};
                            sl_r <= $signed({2'b00, ls1[35:24]}) - $signed({2'b00, ls0[35:24]});
                            sl_g <= $signed({2'b00, ls1[23:12]}) - $signed({2'b00, ls0[23:12]});
                            sl_b <= $signed({2'b00, ls1[11:0]})  - $signed({2'b00, ls0[11:0]});
                            rt_r <= ls1[35:24]; rt_g <= ls1[23:12]; rt_b <= ls1[11:0];
                            nx_r <= f_val[35:24]; nx_g <= f_val[23:12]; nx_b <= f_val[11:0];
                        end
                    endcase
                end
            endcase
        end
    end

    wire        lsc_on = (LSC_EN != 0) && !raw_u;
    wire [11:0] lsc_r  = lsc_on ? acc_r[15:4] : 12'd1024;
    wire [11:0] lsc_g  = lsc_on ? acc_g[15:4] : 12'd1024;
    wire [11:0] lsc_b  = lsc_on ? acc_b[15:4] : 12'd1024;

    // ---------------------------------------------------------------- stage 1: effective gains, black level
    function [15:0] effg;
        input [15:0] g;
        input [11:0] l;
        reg   [27:0] p;
        begin
            p = g * l;
            effg = (|p[27:26]) ? 16'hFFFF : p[25:10];
        end
    endfunction
    function [7:0] blc;
        input [7:0] p;
        input [7:0] b;
        begin blc = (p > b) ? p - b : 8'd0; end
    endfunction
    reg  [15:0] e_r, e_g, e_b;
    reg  [95:0] pb;
    reg         v1, l1, u1, s1;
    wire [7:0]  kr = raw_u ? 8'd0 : BLK_R;
    wire [7:0]  kg = raw_u ? 8'd0 : BLK_G;
    wire [7:0]  kb = raw_u ? 8'd0 : BLK_B;
    integer k0;
    always @(posedge I_clk or negedge I_rst_n) begin
        if (!I_rst_n) begin v1 <= 1'b0; l1 <= 1'b0; u1 <= 1'b0; s1 <= 1'b0; end
        else begin
            v1 <= d_valid; l1 <= d_last & d_valid; u1 <= first;
            s1 <= (d_data[15:8] >= BLK_G + V_LO) && (d_data[23:16] < V_HI) && (d_data[15:8] < V_HI) && (d_data[7:0] < V_HI);
        end
    end
    always @(posedge I_clk) begin
        e_r <= effg(gu_r, lsc_r);
        e_g <= effg(gu_g, lsc_g);
        e_b <= effg(gu_b, lsc_b);
        for (k0 = 0; k0 < 4; k0 = k0 + 1)
            pb[24*k0 +: 24] <= {blc(d_data[24*k0+16 +: 8], kr), blc(d_data[24*k0+8 +: 8], kg), blc(d_data[24*k0 +: 8], kb)};
    end

    // ---------------------------------------------------------------- stage 2: pixel products (R / B: DSP; G: shift-add halves)
    function [19:0] mul4;
        input [15:0] g;
        input [3:0]  n;
        begin
            mul4 = (n[0] ? {4'd0, g} : 20'd0) + (n[1] ? {3'd0, g, 1'b0} : 20'd0) +
                   (n[2] ? {2'd0, g, 2'b0} : 20'd0) + (n[3] ? {1'd0, g, 3'b0} : 20'd0);
        end
    endfunction
    reg [23:0] m_r [0:3];
    reg [23:0] m_b [0:3];
    reg [19:0] m_gl [0:3];
    reg [19:0] m_gh [0:3];
    reg        v2, l2, u2, s2;
    integer k;
    always @(posedge I_clk or negedge I_rst_n) begin
        if (!I_rst_n) begin v2 <= 1'b0; l2 <= 1'b0; u2 <= 1'b0; s2 <= 1'b0; end
        else begin v2 <= v1; l2 <= l1; u2 <= u1; s2 <= s1; end
    end
    always @(posedge I_clk) begin
        for (k = 0; k < 4; k = k + 1) begin
            m_r[k]  <= e_r * pb[24*k+16 +: 8];
            m_gl[k] <= mul4(e_g, pb[24*k+8 +: 4]);
            m_gh[k] <= mul4(e_g, pb[24*k+12 +: 4]);
            m_b[k]  <= e_b * pb[24*k +: 8];
        end
    end

    // ---------------------------------------------------------------- stage 3: saturate, output
    function [7:0] sat12;
        input [23:0] p;
        begin sat12 = (|p[23:20]) ? 8'd255 : p[19:12]; end
    endfunction
    reg [95:0] o_data;
    reg        o_v, o_l, o_u, o_s;
    integer k2;
    always @(posedge I_clk or negedge I_rst_n) begin
        if (!I_rst_n) begin o_data <= 96'd0; o_v <= 1'b0; o_l <= 1'b0; o_u <= 1'b0; o_s <= 1'b0; end
        else begin
            o_v <= v2; o_l <= l2; o_u <= u2; o_s <= s2;
            for (k2 = 0; k2 < 4; k2 = k2 + 1)
                o_data[24*k2 +: 24] <= v2 ? {sat12(m_r[k2]), sat12({4'd0, m_gl[k2]} + {m_gh[k2], 4'd0}), sat12(m_b[k2])} : 24'd0;
        end
    end
    assign O_tdata  = o_data;
    assign O_tvalid = o_v;
    assign O_tlast  = o_l;

    // ---------------------------------------------------------------- closed-loop statistics on the output (first pixel of every VALID beat)
    // valid: the input pixel is above the noise floor in G and not clipped (gray world on near-black noise or on clipped pixels gives wrong
    // colours); s_n = TARGET x the number of valid beats (the exposure target of the counted pixels)
    reg [31:0] s_r, s_g, s_b;
    reg [25:0] s_n;
    wire [8:0]  og  = {1'b0, o_data[15:8]};
    wire [8:0]  otl = og >> GRAY_SH;
    wire        o_gray = (GRAY_SH == 0) ||
                         (({1'b0, o_data[23:16]} + otl >= og) && ({1'b0, o_data[23:16]} <= og + otl) &&
                          ({1'b0, o_data[7:0]}   + otl >= og) && ({1'b0, o_data[7:0]}   <= og + otl));
    wire        o_st = o_s && o_gray;
    wire [31:0] v_r = o_st ? {24'd0, o_data[23:16]} : 32'd0;
    wire [31:0] v_g = o_st ? {24'd0, o_data[15:8]}  : 32'd0;
    wire [31:0] v_b = o_st ? {24'd0, o_data[7:0]}   : 32'd0;
    wire [25:0] v_n = o_st ? TARGET : 26'd0;
    reg [9:0]  oy;
    reg        o_frame;                       // inside a frame that started with a first beat
    reg        fe;                            // a complete frame just ended
    always @(posedge I_clk or negedge I_rst_n) begin
        if (!I_rst_n) begin s_r <= 32'd0; s_g <= 32'd0; s_b <= 32'd0; s_n <= 26'd0; oy <= 10'd0; o_frame <= 1'b0; fe <= 1'b0; end
        else begin
            fe <= 1'b0;
            if (o_v) begin
                if (o_u) begin
                    s_r <= v_r; s_g <= v_g; s_b <= v_b; s_n <= v_n;
                    oy <= 10'd0; o_frame <= 1'b1;
                end
                else begin
                    s_r <= s_r + v_r; s_g <= s_g + v_g; s_b <= s_b + v_b; s_n <= s_n + v_n;
                end
                if (o_l) begin
                    if (o_u ? 1'b0 : (oy == IMG_HEIGHT - 1)) begin fe <= o_frame; o_frame <= 1'b0; end
                    oy <= o_u ? 10'd1 : oy + 10'd1;
                end
            end
        end
    end

    // ---------------------------------------------------------------- after a complete frame (two passes, sequential)
    // pass 0, per channel: er_c = min(65535, gain_c * TN / sum_c)           (sum_c = 0 -> 65535)
    // pass 1, per channel: est_c = er_c * GAIN_MAX / max(er) if max(er) > GAIN_MAX, else er_c   -> the limit keeps the R : G : B ratios
    //                      (a dark scene that wants more than GAIN_MAX gets a darker but still neutral picture); est_c >= GAIN_MIN;
    //                      auto_c = (gain_c + est_c + 1) >> 1
    reg  [31:0] c_sum [0:2];
    reg  [25:0] c_tn;
    reg  [15:0] c_g   [0:2];
    reg  [15:0] c_er  [0:2];
    reg  [1:0]  c_ch;
    reg         c_p;                          // pass
    reg  [2:0]  c_st;                         // 0 idle, 1 multiply, 2 divide start, 3 wait, 4 store, 5 pass-1 decision
    reg  [4:0]  c_i;
    reg  [43:0] c_num;
    reg  [15:0] c_mul;
    wire        dv_busy, dv_done;
    wire [43:0] dv_q;
    wire [31:0] dv_rem;
    reg         dv_start;
    wire [15:0] c_m01 = (c_er[0] > c_er[1]) ? c_er[0] : c_er[1];
    wire [15:0] c_m   = (c_m01 > c_er[2]) ? c_m01 : c_er[2];
    wire        c_lim = (c_m > GAIN_MAX);
    wire [43:0] c_k   = c_p ? {28'd0, GAIN_MAX} : {18'd0, c_tn};
    wire [31:0] c_den = c_p ? {16'd0, c_m} : ((c_sum[c_ch] == 32'd0) ? 32'd1 : c_sum[c_ch]);
    div_seq #(.NW(44), .WD(32)) u_div (
        .clk(I_clk), .rst_n(I_rst_n), .start(dv_start), .num(c_num), .den(c_den),
        .busy(dv_busy), .done(dv_done), .quo(dv_q), .rem(dv_rem)
    );
    wire [15:0] er_new = ((c_sum[c_ch] == 32'd0) || (|dv_q[43:16])) ? 16'hFFFF : dv_q[15:0];
    wire [15:0] est_l  = c_lim ? dv_q[15:0] : c_er[c_ch];
    wire [15:0] est    = (est_l < GAIN_MIN) ? GAIN_MIN : est_l;
    wire [16:0] avg    = {1'b0, c_g[c_ch]} + {1'b0, est} + 17'd1;
    always @(posedge I_clk or negedge I_rst_n) begin
        if (!I_rst_n) begin
            c_st <= 3'd0; c_ch <= 2'd0; c_p <= 1'b0; c_i <= 5'd0; c_num <= 44'd0; c_mul <= 16'd0; dv_start <= 1'b0;
            a_r <= INIT_R; a_g <= INIT_G; a_b <= INIT_B;
            c_sum[0] <= 32'd1; c_sum[1] <= 32'd1; c_sum[2] <= 32'd1; c_g[0] <= 16'd4096; c_g[1] <= 16'd4096; c_g[2] <= 16'd4096;
            c_er[0] <= 16'd4096; c_er[1] <= 16'd4096; c_er[2] <= 16'd4096; c_tn <= 26'd0;
        end
        else begin
            dv_start <= 1'b0;
            case (c_st)
                3'd0: if (fe && s_n >= TNMIN) begin                 // too few valid beats: keep the gains
                    c_sum[0] <= s_r; c_sum[1] <= s_g; c_sum[2] <= s_b; c_tn <= s_n;
                    c_g[0] <= g_r; c_g[1] <= g_g; c_g[2] <= g_b;
                    c_ch <= 2'd0; c_p <= 1'b0; c_st <= 3'd1; c_i <= 5'd0; c_num <= 44'd0; c_mul <= g_r;
                end
                3'd1: begin                                          // c_num = c_mul * c_k, one bit per clock
                    if (c_mul[0]) c_num <= c_num + (c_k << c_i);
                    c_mul <= c_mul >> 1;
                    c_i   <= c_i + 5'd1;
                    if (c_i == 5'd15) c_st <= 3'd2;
                end
                3'd2: begin dv_start <= 1'b1; c_st <= 3'd3; end
                3'd3: if (dv_done) c_st <= 3'd4;
                3'd4: begin
                    if (!c_p) begin
                        c_er[c_ch] <= er_new;
                        if (c_ch == 2'd2) begin c_p <= 1'b1; c_ch <= 2'd0; c_st <= 3'd5; end
                        else begin
                            c_ch <= c_ch + 2'd1; c_st <= 3'd1; c_i <= 5'd0; c_num <= 44'd0;
                            c_mul <= (c_ch == 2'd0) ? c_g[1] : c_g[2];
                        end
                    end
                    else begin
                        case (c_ch)
                            2'd0: a_r <= avg[16:1];
                            2'd1: a_g <= avg[16:1];
                            default: a_b <= avg[16:1];
                        endcase
                        if (c_ch == 2'd2) c_st <= 3'd0;
                        else begin c_ch <= c_ch + 2'd1; c_st <= 3'd5; end
                    end
                end
                default: begin                                       // pass 1: scale this channel only when the largest estimate is over the limit
                    if (c_lim) begin c_st <= 3'd1; c_i <= 5'd0; c_num <= 44'd0; c_mul <= c_er[c_ch]; end
                    else c_st <= 3'd4;
                end
            endcase
        end
    end

endmodule
